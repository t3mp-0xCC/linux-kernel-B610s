## arch/arm/mach-balong/Kconfig
```kconfig
menu "balong Soc Type"

config  BALONG_CACHE_L2X0
	bool "balong l2c"
	default n
	help 
	    support for hisilicon balong l2cache

config  BALONG_MINI_SYSTEM
	bool "balong mini system"
	default n
	help 
	    support for hisilicon balong mini system
	    
config  BALONG_SYSCNT
	bool "balong syscnt"
	default n
	help 
	    support for hisilicon balong syscnt
	    
config BALONG_SYS_TIMER
	bool "balong sys timer"
	default n
	help 
	    support for hisilicon balong sys timer


endmenu
```

## drivers/hisi/Kconfig
```kconfig
menu "HISI(HI6950) Drivers"

source "drivers/hisi/sec/Kconfig"
source "drivers/hisi/balong_fs/Kconfig"
source "drivers/hisi/ddr/Kconfig"
source "drivers/hisi/edma/Kconfig"
source "drivers/hisi/modem/Kconfig"
source "drivers/hisi/hkadc/Kconfig"
source "drivers/hisi/emi/Kconfig"
source "drivers/hisi/multicarrier/Kconfig"
source "drivers/hisi/spe/Kconfig"
source "drivers/hisi/dialup_hsuart/Kconfig"
source "drivers/hisi/cpuidle/Kconfig"
source "drivers/hisi/pm/Kconfig"
source "drivers/hisi/sdio_slave/Kconfig"
source "drivers/hisi/pinctrl/Kconfig"
source "drivers/hisi/watchpoint/Kconfig"
source "drivers/hisi/tzdriver/Kconfig"
source "drivers/hisi/rdr/Kconfig"
endmenu
```

## drivers/hisi/ap_dump/Kconfig
```kconfig
#
# balong early mount fs 
#

comment "balong AP KERNEL DUMP"

config BALONG_EARLY_FS
	tristate "balong ap kernrl dump"
	default n
	help
	  balong ap kernrl dump
	  
```

## drivers/hisi/cpuidle/Kconfig
```kconfig
config HAVE_CPU_IDLE
    bool "balong cpu idle support"
    select CPU_IDLE
    default n
	help
	   support for the Hisilicon Balong cpu idle.
```

## drivers/hisi/emi/Kconfig
```kconfig
#
# Balong EMI  configuration
#

comment "balong emi driver"

config EMI_SUPPORT
	tristate "support emi"
	help
	  EMI driver
	  
```

## drivers/hisi/multicarrier/Kconfig
```kconfig
#
# Balong multicarrier driver configuration
#

comment "balong multicarrier driver"

config MULTI_CARRIER
	tristate "multicarrier"
	help
		multicarrier driver
```

## drivers/hisi/rdr/Kconfig
```kconfig
#
# Balong rdr configuration
#

config BALONG_RDR
	tristate "balong rdr"
	default n
	help
		balong rdr for kernel
```

## drivers/hisi/sec/Kconfig
```kconfig
#
# image check
#

comment "image check driver"

config SEC_CHECK
	tristate "image check driver"
	default n
	help
	  image check driver

config KDF_HASH
	tristate "kdf hash driver"
	default n
	help
	  image check driver
```

## drivers/hisi/spe/spe_drv/Kconfig
```kconfig
menu "smart packet process"
	depends on NET && INET && NETFILTER && NF_CONNTRACK

config BALONG_SPE
	tristate "smart packet process module"
	help
	  If this option is enabled, the kernel will include support
	  for soft fast forward.

if BALONG_SPE
config BALONG_SPE_SIM
	bool "spe simulator"
	help
	  Enable to use spe simulator.

config BALONG_SPE_EVENT_BUILTIN_BUF
	bool "spe builtin event buffer"
	help
	  Enable to use spe builtin event buffer.

config BALONG_SPE_IPFW_MUTENODE
	bool "spe ip fw use mutenode"
	help
	  Enable to use spe ip fw subnode.

config BALONG_SPE_TD_TIMESTAMP
	bool "spe td use timestamp"
	help
	  Enable to use spe td timestamp.

config BALONG_SPE_DEBUG
	bool "debug info for spe module"
	help
	  Enable to check the debug info. Strongly suggested to disable 
	  when compiled an release version

config BALONG_SPE_DFS
	bool "spe dfs"
	help
	  Enable to use spe dfs.	  
	  
endif #if BALONG_SPE
endmenu
```

## drivers/hisi/watchpoint/Kconfig
```kconfig
#
# Balong dump configuration
#

config HISI_WATCHPOINT
	tristate "hisi watchpoint"
	default n
	help
		balong watchpoint for kernel
```

## drivers/wifi/Kconfig
```kconfig
config WLAN_BCM_CHIP
	bool "WIFI CHIP SUPPORT"
	depends on WLAN
	select WIRELESS_EXT
	#select WEXT_CORE
	select WEXT_PRIV
	#select WEXT_PROC
	---help---
	  The wifi chip configuration. 
	  
config BCM_FLWCTL
	bool "BROADCOM FLWCTL FIX"
	depends on WLAN_BCM_CHIP 
	help
		select it if you'd like to fix flow control issue.

config WLAN_RTL_CHIP
	bool "WIFI CHIP SUPPORT"
	depends on WLAN
	select WIRELESS_EXT
	select WEXT_CORE
	select WEXT_PRIV
	select WEXT_PROC
	---help---
	  The wifi chip configuration. 
```

## kernel_B610s-77a/drivers/clk/balong/Kconfig
```kconfig
config BALONG_CLK
	depends on COMMON_CLK
	bool "clock driver of HISI Soc"
	default y

config CLK_DEBUG
	depends on COMMON_CLK_DEBUG
	bool "debug optinon for clock driver of HiSI Soc"
	default y

config BALONG_CLK_ALWAYS_ON
	depends on BALONG_CLK
	bool "all clocks of Hisi Soc are always on"
	default n
```

## kernel_B610s-77a/drivers/hisi/coresight/Kconfig
```kconfig
menuconfig CORESIGHT
	bool "CoreSight Tracing Support"
	help
	  This framework provides an interface for the CoreSight debug and
	  trace drivers to register themselves with. It's intended to build
	  up a topological view of the CoreSight components and configure
	  the right series of components on user input via sysfs. It also
	  provides status information to user space applications through
	  the debugfs interface.

if CORESIGHT

config CORESIGHT_LINKS_AND_SINKS
	bool "CoreSight Link and Sink drivers"
	help
	  This enables support for CoreSight link and sink drivers that are
	  responsible for transporting and collecting the trace data
	  respectively.

config CORESIGHT_SOURCE_ETM
	bool "CoreSight Embedded Trace Macrocell driver"
	select CORESIGHT_LINKS_AND_SINKS
	help
	  This driver provides support for processor tracing which allows
	  tracing the instructions that the processor is executing. This is
	  primarily useful for instruction level tracing.

config CORESIGHT_SOURCE_ETM_DEFAULT_ENABLE
	bool "Turn on CoreSight ETM tracing by default"
	depends on CORESIGHT_SOURCE_ETM
	help
	  Turns on CoreSight ETM tracing (processor tracing) by default.
	  Otherwise, tracing is disabled by default but can be enabled via
	  debugfs.

	  If unsure, say 'N' here to avoid unwanted power consumption.
endif
```

## kernel_B610s-77a/drivers/hisi/ddr/Kconfig
```kconfig
#
# Balong ddr test configuration
#

comment "ddr test in kernel "

config DDR_TEST_KERNEL
	tristate "support ddr test kernel"
	default n
	help
	  ddr test
	  
```

## kernel_B610s-77a/drivers/hisi/dialup_hsuart/Kconfig
```kconfig
#
# Balong dialup hsuart driver configuration
#

comment "dialup uart driver"

config DIALUP_UART
	tristate "dialup uart "
	default n
	help
		dialup uart
		
	
```

## kernel_B610s-77a/drivers/hisi/modem/Kconfig
```kconfig
menu "Modem Drivers"

comment "tlmsp tlps gumsp gups taf acore image"

config BALONG_OAM_PS
	tristate "support tlmsp tlps gumsp gups taf"
	default n
	help
	 tlmsp tlps gumsp gups taf acore image

source "drivers/hisi/modem/drv/Kconfig"

endmenu
```

## kernel_B610s-77a/drivers/hisi/pinctrl/Kconfig
```kconfig
#
# pinctrl balong configuration
#

comment "balong pinctrl"

config PINCTRL_BALONG
	tristate "pinctrl"
	help
	  PINCTRL_BALONG 
	  
```

## kernel_B610s-77a/drivers/hisi/pm/Kconfig
```kconfig
config BALONG_PM_SUSPEND
	bool "balong pm suspend"
	select SUSPEND
	select ARCH_SUSPEND_POSSIBLE
	select PM
	select PM_SLEEP
	select CPU_V7
	default n
	help
	support for pm suspend
```

## kernel_B610s-77a/drivers/hisi/spe/Kconfig
```kconfig
menu "SPE Drivers"

source "drivers/hisi/spe/spe_drv/Kconfig"

source "drivers/hisi/spe/spe_simulator/Kconfig"

endmenu
```

## kernel_B610s-77a/drivers/hisi/spe/spe_simulator/Kconfig
```kconfig
menu "spe simulator"
	depends on NET && INET && NETFILTER && NF_CONNTRACK

config SPE_SIM
	bool "spe simulator module"
	help
	  If this option is enabled, the kernel will include support
	  for spe simulator.
endmenu
```

## kernel_B610s-77a/drivers/huawei/Kconfig
```kconfig
config MBB_MLOG_DRV
	tristate "mobilelog driver"
	default n
	help
	  mobilelog driver

config MBB_MLOG_DRV_TEST
	tristate "mobilelog driver test"
	default n
	help
	  mobilelog driver test
	  
config MBB_DLOAD
	tristate "huaweidload driver"
	default n
	help
	  huaweidload driver test


config FLIGHT_MODE
        tristate "flightmode"
        default n	
	help
          flightmode driver
```

## kernel_B610s-77a/drivers/net/ethernet/stmicro/stmmac_avb/Kconfig
```kconfig
config NEW_STMMAC_ETH
	tristate "STMicroelectronics 10/100/1000 Ethernet driver"
	depends on HAS_IOMEM && HAS_DMA
	select NET_CORE
	select MII
	select PHYLIB
	select CRC32
	select PTP_1588_CLOCK
	---help---
	  This is the driver for the Ethernet IPs are built around a
	  Synopsys IP Core and only tested on the STMicroelectronics
	  platforms.

if NEW_STMMAC_ETH

config NEW_STMMAC_PLATFORM
	bool "STMMAC Platform bus support"
	depends on NEW_STMMAC_ETH
	default y
	---help---
	  This selects the platform specific bus support for
	  the stmmac device driver. This is the driver used
	  on many embedded STM platforms based on ARM and SuperH
	  processors.
	  If you have a controller with this interface, say Y or M here.

	  If unsure, say N.

config NEW_STMMAC_PCI
	bool "STMMAC PCI bus support"
	depends on NEW_STMMAC_ETH && PCI
	---help---
	  This is to select the Synopsys DWMAC available on PCI devices,
	  if you have a controller with this interface, say Y or M here.

	  This PCI support is tested on XLINX XC2V3000 FF1152AMT0221
	  D1215994A VIRTEX FPGA board.

	  If unsure, say N.

config NEW_GMAC_TEST
	bool "gmac test support"
	depends on NEW_STMMAC_ETH
	default n
	---help---
	  This selects the gmac test file
	  If you have wana test the gmac, say Y here.
	  If unsure, say N.	  
	  

config NEW_STMMAC_DEBUG_FS
	bool "Enable monitoring via sysFS "
	default n
	depends on NEW_STMMAC_ETH && DEBUG_FS
	---help---
	  The stmmac entry in /sys reports DMA TX/RX rings
	  or (if supported) the HW cap register.

config NEW_STMMAC_DA
	bool "STMMAC DMA arbitration scheme"
	default n
	---help---
	  Selecting this option, rx has priority over Tx (only for Giga
	  Ethernet device).
	  By default, the DMA arbitration scheme is based on Round-robin
	  (rx:tx priority is 1:1).

config NEW_STMMAC_IPF_SIM
	bool "STMMAC IPF simulator"
	default n
	---help---
		STMMAC IPF simulator

config BALONG_AVB
	bool "BALONG_AVB"
	default y
	---help---
		This is support tested on BALONG progect.

endif
```

## kernel_B610s-77a/drivers/usb/dwc3_balong/Kconfig
```kconfig
config USB_DWC3_BALONG
	tristate "DesignWare USB3 DRD Core Support For Balong"
	depends on (USB || USB_GADGET) && GENERIC_HARDIRQS
	select USB_XHCI_PLATFORM if USB_SUPPORT && USB_XHCI_HCD
	select USB_PHY
	select USB_BCCTRL
	select BALONG_USB2PHY
	select BALONG_USB3PHY
	help
	  Say Y or M here if your system has a Dual Role SuperSpeed
	  USB controller based on the DesignWare USB3 IP Core.

	  If you choose to build this driver is a dynamically linked
	  module, the module will be called dwc3.ko.

if USB_DWC3_BALONG

choice
	bool "DWC3 Mode Selection For Balong"
	default USB_DWC3_DUAL_ROLE if (USB && USB_GADGET)
	default USB_DWC3_HOST if (USB && !USB_GADGET)
	default USB_DWC3_GADGET if (!USB && USB_GADGET)

config USB_DWC3_HOST
	bool "Host only mode"
	depends on USB=y || USB=USB_DWC3_BALONG
	help
	  Select this when you want to use DWC3 in host mode only,
	  thereby the gadget feature will be regressed.

config USB_DWC3_GADGET
	bool "Gadget only mode"
	depends on USB_GADGET=y || USB_GADGET=USB_DWC3_BALONG
	help
	  Select this when you want to use DWC3 in gadget mode only,
	  thereby the host feature will be regressed.

config USB_DWC3_DUAL_ROLE
	bool "Dual Role mode"
	depends on ((USB=y || USB=USB_DWC3_BALONG) && (USB_GADGET=y || USB_GADGET=USB_DWC3_BALONG))
	help
	  This is the default mode of working of DWC3 controller where
	  both host and gadget features are enabled.

endchoice

config USB_BCCTRL
	bool "Balong usb bcctrl"
	help
		buttery control

config USB_DWC3_BALONG_PM
	bool "Dwc3 balong pm support"
	help
	  select it if you'd like to use dwc3 balong pm support.

config GADGET_CORE_HIBERNATION
	bool "Support USB core hibernation"
	help
	  Say Y here to support USB core hibernation.
	  This can put USB and app cpu into sleep when
	  usb port still connected.
	 
	  
config USB_U1U2_DISABLE
	bool "Disable USB3.0 U1&U2 Link state"
	help
	  Say Y here to disable USB3.0 U1&U2 Link state.
	  This is for evade balong chip defect.
	  
config GADGET_SUPPORT_REMOTE_WAKEUP
	bool "Support the remote wakeup"
	help
	  Say Y here to support remote gadget remote wakeup.

config DWC3_INTERRUPT_GATHER
	bool "dwc3 interrupt gather"
	help
		select it if you'd like to reduce the interrupt pressure.

config USB_CDC_NCM_DWC_CACHE_TRB_NUM
        int "Number of synopsys ip trb caches"
        default 16

config USB_DWC3_SKIP_IRQTHREAD
        bool "dwc3 interrupt skip irqthread"
	help
		select it if you'd like to skip irqthread.

config USB_DWC3_NOLOOP_SGS 
        bool "dwc3 not loop sgs"
	help
		select it if you'd like to skip loop sgs.

config USB_DWC3_DEBUG
	bool "Enable Debugging Messages"
	help
	  Say Y here to enable debugging messages on DWC3 Driver.

config USB_DWC3_VERBOSE
	bool "Enable Verbose Debugging Messages"
	depends on USB_DWC3_DEBUG
	help
	  Say Y here to enable verbose debugging messages on DWC3 Driver.

config USB_DWC3_DBG
	bool "dwc3 dbg(balong) system"
	help
		select it if you'd like to use dwc3 dbg system.

endif
```

## kernel_B610s-77a/sound/soc/balong/Kconfig
```kconfig
#
# Balong SoC audio configuration
#

menu "Hisi Balong Sound"

# slic balong
source "sound/soc/balong/slic/Kconfig"

# audio balong
source "sound/soc/balong/audio/Kconfig"

#solution pcm drv
source "sound/soc/balong/solution/Kconfig"
endmenu
```

## kernel_B610s-77a/sound/soc/balong/audio/Kconfig
```kconfig
config SND_AUDIO_BALONG
	tristate "ASoC Audio support for Balong"
	select SND_SOC_WM8990 if I2C
	help
	  Say Y or M if you want to add support for audio codecs attached
	  to the Balong SoCs' AUDIO interfaces.
```
